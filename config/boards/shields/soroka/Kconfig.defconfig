## config/boards/shields/soroka/Kconfig.defconfig
```kconfig
# Copyright (c) 2022 The ZMK Contributors
# SPDX-License-Identifier: MIT
if soroka
	config ZMK_SPLIT
		default n

	config USB_DEVICE_PRODUCT
		default "Soroka"

	config USB_DEVICE_VID
		default "0x0000"

	config USB_DEVICE_PID
		default "0xFEED"

	config USB_DEVICE_MANUFACTURER
		default "aroum"
		
	if ZMK_RGB_UNDERGLOW

	config ZMK_RGB_UNDERGLOW_EXT_POWER
		default y

	config ZMK_RGB_UNDERGLOW_BRT_MAX
		default 50

	config ZMK_RGB_UNDERGLOW_ON_START
		default n

	config ZMK_RGB_UNDERGLOW_AUTO_OFF_IDLE
		default y

	config ZMK_RGB_UNDERGLOW_AUTO_OFF_USB
		default y

	#ZMK_RGB_UNDERGLOW
endif
```
